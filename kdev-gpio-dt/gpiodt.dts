/dts-v1/;
/plugin/;

/ {
    compatible = "brcm,bcm2711";

    fragment@0 {
        target = <&gpio>;
        __overlay__ {
            pinctrl-names = "default";
            pinctrl-0 = <&gpiodt_pin_17>;

            gpiodt_pin_17: gpiodt_pin_17 {
                brcm,pins = <17>;     /* GPIO17 */
                brcm,function = <1>; /* Output */
            };
        };
    };
};